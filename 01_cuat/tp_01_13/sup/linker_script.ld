__VIDEO_BUFFER_LINEAR_ADDR = 0x00010000;
__VIDEO_BUFFER_START = __VIDEO_BUFFER_LINEAR_ADDR;
__VIDEO_BUFFER_LEN = 0x8000;
__VIDEO_BUFFER_END = __VIDEO_BUFFER_START + __VIDEO_BUFFER_LEN -1;

__PAGE_TABLES_LINEAR_ADDR = 0x00110000;
__PAGE_DIRECTORY_ADDR_TASK0 = __PAGE_TABLES_LINEAR_ADDR;
__PAGE_TABLE_0x000_TASK0_ADDR = __PAGE_DIRECTORY_ADDR_TASK0 + 0x1000;
__PAGE_TABLE_0x001_TASK0_ADDR = __PAGE_DIRECTORY_ADDR_TASK0 + 0x2000;
__PAGE_TABLE_0x07F_TASK0_ADDR = __PAGE_DIRECTORY_ADDR_TASK0 + 0x3000;
__PAGE_TABLE_0x3FF_TASK0_ADDR = __PAGE_DIRECTORY_ADDR_TASK0 + 0x4000;

__PAGE_DIRECTORY_ADDR_TASK1 = __PAGE_TABLES_LINEAR_ADDR + 0x10000;
__PAGE_TABLE_0x000_TASK1_ADDR = __PAGE_DIRECTORY_ADDR_TASK1 + 0x1000;
__PAGE_TABLE_0x001_TASK1_ADDR = __PAGE_DIRECTORY_ADDR_TASK1 + 0x2000;
__PAGE_TABLE_0x07F_TASK1_ADDR = __PAGE_DIRECTORY_ADDR_TASK1 + 0x3000;
__PAGE_TABLE_0x3FF_TASK1_ADDR = __PAGE_DIRECTORY_ADDR_TASK1 + 0x4000;

__PAGE_DIRECTORY_ADDR_TASK2 = __PAGE_TABLES_LINEAR_ADDR + 0x20000;
__PAGE_TABLE_0x000_TASK2_ADDR = __PAGE_DIRECTORY_ADDR_TASK2 + 0x1000;
__PAGE_TABLE_0x001_TASK2_ADDR = __PAGE_DIRECTORY_ADDR_TASK2 + 0x2000;
__PAGE_TABLE_0x07F_TASK2_ADDR = __PAGE_DIRECTORY_ADDR_TASK2 + 0x3000;
__PAGE_TABLE_0x3FF_TASK2_ADDR = __PAGE_DIRECTORY_ADDR_TASK2 + 0x4000;

__PAGE_TABLES_QTY_FIX = 4;
__PAGE_TABLES_SIZE = (__PAGE_TABLES_QTY_FIX + 1) * 0x1000;

/*		HEREDADO DEL EJ 12 		*/
/*Para paginar toda la RAM (0x0000 0000 a 0x1FFF FFFF) necesito tener tablas de paginación desde 0x000 hasta 0x07F,
que son 127 páginas. Debo agregarle el bloque del directorio y lo de la ROM (tabla 0x3FF), siendo en total 129 páginas*/
/*__PAGE_TABLES_QTY_MAX = 127 + 1; */	/* 127 tablas de para RAM y una tabla para la ROM*/
/*__PAGE_TABLES_SIZE = (__PAGE_TABLES_QTY_MAX + 1) * 0x1000;*/
__PHYSICAL_ADDR_NEW_PAGES = 0x08000000;

__DIGIT_TABLE_LINEAR_ADDR = 0x00510000;
__DIGIT_TABLE_START = __DIGIT_TABLE_LINEAR_ADDR;
__DIGIT_TABLE_SIZE = 0x10000;					/* 64kb*/
__DIGIT_TABLE_END = __DIGIT_TABLE_START + __DIGIT_TABLE_SIZE - 1;

__KERNEL_STACK_LINEAR_ADDR = 0x1FFFB000;
__KERNEL_STACK_START = __KERNEL_STACK_LINEAR_ADDR;
__KERNEL_STACK_SIZE = 0x1000;											/*Tamanio de pila 16kb*/
__KERNEL_STACK_END = __KERNEL_STACK_START + __KERNEL_STACK_SIZE - 1; 	/*Fin de pila 0x1FFFDFFF*/

__TASK0_STACK_LINEAR_ADDR = 0x00613000;
__TASK0_STACK_START = __TASK0_STACK_LINEAR_ADDR;
__TASK0_STACK_SIZE = 0x1000;							
__TASK0_STACK_END = __TASK0_STACK_START + __TASK0_STACK_SIZE - 1; 	

__TASK1_STACK_LINEAR_ADDR = 0x00613000;
__TASK1_STACK_START = __TASK1_STACK_LINEAR_ADDR;
__TASK1_STACK_SIZE = 0x1000;							
__TASK1_STACK_END = __TASK1_STACK_START + __TASK1_STACK_SIZE - 1; 	

__TASK2_STACK_LINEAR_ADDR = 0x00613000;
__TASK2_STACK_START = __TASK2_STACK_LINEAR_ADDR;
__TASK2_STACK_SIZE = 0x1000;							
__TASK2_STACK_END = __TASK2_STACK_START + __TASK2_STACK_SIZE - 1; 	



/****************PHYSICAL ADDRESS SECTIONS****************/
__ISR_PHYSICAL_ADDR 			= 	0x00000000;
__VIDEO_BUFFER_PHYSICAL_ADDR 	= 	0x000B8000;
__SYS_TABLES_PHYSICAL_ADDR 		= 	0x00100000;
__PAGE_TABLES_PHYISICAL_ADDR 	= 	0x00110000;
__COPY_PHYSICAL_ADDR			=	0x00200000;
__ROUTINES_PHYSICAL_ADDR 		=	0x00210000;
__INIT_RAM_PHYSICAL_ADDR		= 	0x00220000;
__KERNEL_PHYSICAL_ADDR			= 	0X00500000;
__TASK0_TEXT_PHYSICAL_ADDR		=	0x00501000;
__TASK0_BSS_PHYSICAL_ADDR 		=	0x00502000;
__TASK0_DATA_PHYSICAL_ADDR		=	0x00503000;
__DIGIT_TABLE_PHYSICAL_ADDR 	= 	0x00510000;
__TASK1_TEXT_PHYSICAL_ADDR		=	0x00521000;
__TASK1_BSS_PHYSICAL_ADDR 		=	0x00522000;
__TASK1_DATA_PHYSICAL_ADDR		=	0x00523000;
__TASK2_TEXT_PHYSICAL_ADDR		=	0x00531000;
__TASK2_BSS_PHYSICAL_ADDR 		=	0x00532000;
__TASK2_DATA_PHYSICAL_ADDR		=	0x00533000;
__DATA_PHYSICAL_ADDR 			= 	0x005E0000;
__BSS_PHYSICAL_ADDR 			= 	0x005F0000;
__KERNEL_STACK_PHYSICAL_ADDR	= 	0x1FFFB000;
__TASK0_STACK_PHYSICAL_ADDR 	= 	0x1FFFC000;
__TASK1_STACK_PHYSICAL_ADDR 	= 	0x1FFFE000;
__TASK2_STACK_PHYSICAL_ADDR 	= 	0x1FFFD000;
__INIT_PHYSICAL_ADDR 			=	0xFFFF0000;
__RESET_PHYSICAL_ADDR 			=	0xFFFFFFF0;
/********************************************************/

MEMORY
{
	ram (rwx) : ORIGIN = 0x00000000, LENGTH = 0xFFFF0000
	rom(rx) : ORIGIN = 0xFFFF0000, LENGTH = 0xFFF0
	rom_reset (rx) : ORIGIN = 0xFFFFFFF0, LENGTH = 0x10		/*Preservo de que el codigo de rom no me pise el codigo de reset*/
}



SECTIONS
{	
	.init 0xFFFF0000 : 
		{	__INIT_LINEAR_ADDR = .;
			*(.init)
		} AT >rom


	.isr 0x00000000 :
		{
		__ISR_LINEAR_ADDR = .;
		__ISR_START_RAM = __ISR_LINEAR_ADDR;
		__ISR_START_ROM = LOADADDR(.isr);
		*(.isr);
		} AT >rom


	.sys_tables 0x00100000 :
		{
		__SYS_TABLES_LINEAR_ADDR = .;
		__SYS_TABLES_RAM = __SYS_TABLES_LINEAR_ADDR;
		__SYS_TABLES_ROM = LOADADDR(.sys_tables);
		*(.sys_tables);
		} AT >rom

	.copy 0x00200000 :
		{
		__COPY_LINEAR_ADDR = .;
		__COPY_IN_RAM = __COPY_LINEAR_ADDR;
		__COPY_IN_ROM = LOADADDR(.copy);
		*(.copy)
		} AT >rom


	.routines 0x00210000 :
		{
		__ROUTINES_LINEAR_ADDR = .;
		__ROUTINES_START_RAM = __ROUTINES_LINEAR_ADDR; 
		__ROUTINES_START_ROM = LOADADDR(.routines);
		__KEYBOARD_ROUTINES = .;
		*(.keyboard_routines);  /*Voy a colocar todo lo que encuentre en sections routines en los asm*/
		__SCREEN_ROUTINES = .;
		*(.screen_routines);
		__PAGINATION_ROUTINES = .;
		*(.pagination_routines);
		} AT >rom

	.init_RAM 0x00220000 :
		{
			__INIT_RAM_LINEAR_ADDR = .;
			__INIT_RAM = __INIT_RAM_LINEAR_ADDR;
			__INIT_RAM_LMA = LOADADDR(.init_RAM);
			*(.init_RAM);
		} AT >rom

	.kernel 0x00500000 :
		{ 
		__KERNEL_LINEAR_ADDR = .;
		__KERNEL_START_RAM = __KERNEL_LINEAR_ADDR; 
		__KERNEL_START_ROM = LOADADDR(.kernel);
		*(.nucleo);
		} AT >rom

	.task0_TEXT 0x00610000 :
		{
		__TASK0_TEXT_LINEAR_ADDR = .;
		__TASK0_TEXT_START_RAM = __TASK0_TEXT_LINEAR_ADDR;
		__TASK0_TEXT_START_ROM = LOADADDR(.task0_TEXT);
		*(.task0_TEXT);
		} AT >rom

	.task0_BSS 0x00611000 :
		{
		__TASK0_BSS_LINEAR_ADDR = .;
		__TASK0_BSS_START_RAM = __TASK0_BSS_LINEAR_ADDR;
		__TASK0_BSS_START_ROM = LOADADDR(.task0_BSS);
		*(.task0_BSS);
		} AT >rom	

	.task0_DATA 0x00612000 :
		{
		__TASK0_DATA_LINEAR_ADDR = .;
		__TASK0_DATA_START_RAM = __TASK0_DATA_LINEAR_ADDR;
		__TASK0_DATA_START_ROM = LOADADDR(.task0_DATA);
		*(.task0_DATA);
		*(.tss_TASK0);
		} AT >rom	

	.task1_TEXT 0x00610000 :
		{
		__TASK1_TEXT_LINEAR_ADDR = .;
		__TASK1_TEXT_START_RAM = __TASK1_TEXT_LINEAR_ADDR;
		__TASK1_TEXT_START_ROM = LOADADDR(.task1_TEXT);
		*(.task1_TEXT);
		} AT >rom

	.task1_BSS 0x00611000 :
		{
		__TASK1_BSS_LINEAR_ADDR = .;
		__TASK1_BSS_START_RAM = __TASK1_BSS_LINEAR_ADDR;
		__TASK1_BSS_START_ROM = LOADADDR(.task1_BSS);
		*(.task1_BSS);
		} AT >rom	

	.task1_DATA 0x00612000 :
		{
		__TASK1_DATA_LINEAR_ADDR = .;
		__TASK1_DATA_START_RAM = __TASK1_DATA_LINEAR_ADDR;
		__TASK1_DATA_START_ROM = LOADADDR(.task1_DATA);
		*(.task1_DATA);
		*(.tss_TASK1);
		} AT >rom	

	.task2_TEXT 0x00610000 :
		{
		__TASK2_TEXT_LINEAR_ADDR = .;
		__TASK2_TEXT_START_RAM = __TASK2_TEXT_LINEAR_ADDR;
		__TASK2_TEXT_START_ROM = LOADADDR(.task2_TEXT);
		*(.task2_TEXT);
		} AT >rom

	.task2_BSS 0x00611000 :
		{
		__TASK2_BSS_LINEAR_ADDR = .;
		__TASK2_BSS_START_RAM = __TASK2_BSS_LINEAR_ADDR;
		__TASK2_BSS_START_ROM = LOADADDR(.task2_BSS);
		*(.task2_BSS);
		} AT >rom	

	.task2_DATA 0x00612000 :
		{
		__TASK2_DATA_LINEAR_ADDR = .;
		__TASK2_DATA_START_RAM = __TASK2_DATA_LINEAR_ADDR;
		__TASK2_DATA_START_ROM = LOADADDR(.task2_DATA);
		*(.task2_DATA);
		*(.tss_TASK2);
		} AT >rom	

	.datos 0x005E0000 :
		{
		__DATA_LINEAR_ADDR = .;
		__DATOS_START_RAM = __DATA_LINEAR_ADDR;
		__DATOS_START_ROM = LOADADDR(.datos);
		*(.datos);
		} AT >rom

	.bss 0x005F0000 :
		{
		__BSS_LINEAR_ADDR = .;
		__BSS_START = __BSS_LINEAR_ADDR;
		*(.bss);
		} AT >rom

	.reset 0xFFFFFFF0:
		{
		__RESET_LINEAR_ADDR = .;
			*(.reset)
		} AT >rom_reset
}

__ISR_LEN 			= SIZEOF(.isr);
__SYS_TABLES_LEN 	= SIZEOF(.sys_tables);
__COPY_LEN 			= SIZEOF(.copy);
__ROUTINES_LEN 		= SIZEOF(.routines);
__INIT_RAM_LEN 		= SIZEOF(.init_RAM);
__KERNEL_LEN 		= SIZEOF(.kernel);
__TASK0_TEXT_LEN 	= SIZEOF(.task0_TEXT);
__TASK0_BSS_LEN 	= SIZEOF(.task0_BSS);
__TASK0_DATA_LEN 	= SIZEOF(.task0_DATA);
__TASK1_TEXT_LEN 	= SIZEOF(.task1_TEXT);
__TASK1_BSS_LEN 	= SIZEOF(.task1_BSS);
__TASK1_DATA_LEN 	= SIZEOF(.task1_DATA);
__TASK2_TEXT_LEN 	= SIZEOF(.task2_TEXT);
__TASK2_BSS_LEN 	= SIZEOF(.task2_BSS);
__TASK2_DATA_LEN 	= SIZEOF(.task2_DATA);
__DATOS_LEN 		= SIZEOF(.datos);
__BSS_LEN 			= SIZEOF(.bss);
__INIT_LEN 			= 0X4000;
__RESET_LEN 		= SIZEOF(.reset);




/* Lo que es con . es dirección virtual*/
/* Lo que es con AT es dirección de carga*/